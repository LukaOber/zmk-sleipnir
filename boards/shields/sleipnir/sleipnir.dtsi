#define TIMEOUT_COMBO_2 150
#define TIMEOUT_COMBO_3 150
#define TIMEOUT_COMBO_4 150
#define TIMEOUT_COMBO_5 150

#define TIMEOUT_LAYER_HOLD 175
#define TIMEOUT_LAYER_LONG_HOLD 250
#define TIMEOUT_STICKY_LEADER_KEY 5000

#define QUICK_TAP_TIME 200

#define LAYER_ID_BASE 0
#define LAYER_ID_SYM  1
#define LAYER_ID_NAV  2
#define LAYER_ID_MWS  3

#define MAKE_COMBOS(SUFFIX, KEY_SPACE, KEY_O, KEY_N, KEY_A, KEY_H, KEY_E, KEY_BSPC, KEY_T) \
        combo_l_##SUFFIX { layers = <LAYER_ID_BASE>; timeout-ms = <TIMEOUT_COMBO_2>; key-positions = <KEY_O KEY_N>; bindings = <&kp L>; }; \
        combo_r_##SUFFIX { layers = <LAYER_ID_BASE>; timeout-ms = <TIMEOUT_COMBO_2>; key-positions = <KEY_O KEY_H>; bindings = <&kp R>; }; \
        combo_b_##SUFFIX { layers = <LAYER_ID_BASE>; timeout-ms = <TIMEOUT_COMBO_2>; key-positions = <KEY_O KEY_A>; bindings = <&kp B>; }; \
        combo_g_##SUFFIX { layers = <LAYER_ID_BASE>; timeout-ms = <TIMEOUT_COMBO_2>; key-positions = <KEY_O KEY_E>; bindings = <&kp G>; }; \
        combo_y_##SUFFIX { layers = <LAYER_ID_BASE>; timeout-ms = <TIMEOUT_COMBO_2>; key-positions = <KEY_N KEY_A>; bindings = <&kp Y>; }; \
        combo_f_##SUFFIX { layers = <LAYER_ID_BASE>; timeout-ms = <TIMEOUT_COMBO_2>; key-positions = <KEY_H KEY_E>; bindings = <&kp F>; }; \
        combo_x_##SUFFIX { layers = <LAYER_ID_BASE>; timeout-ms = <TIMEOUT_COMBO_3>; key-positions = <KEY_O KEY_N KEY_A>; bindings = <&kp X>; }; \
        combo_q_##SUFFIX { layers = <LAYER_ID_BASE>; timeout-ms = <TIMEOUT_COMBO_3>; key-positions = <KEY_O KEY_H KEY_E>; bindings = <&kp Q>; }; \
        combo_comma_##SUFFIX   { layers = <LAYER_ID_BASE>; timeout-ms = <TIMEOUT_COMBO_3>; key-positions = <KEY_H KEY_A>; bindings = <&kp COMMA>; }; \
        combo_period_##SUFFIX  { layers = <LAYER_ID_BASE>; timeout-ms = <TIMEOUT_COMBO_3>; key-positions = <KEY_N KEY_E>; bindings = <&kp PERIOD>; }; \
        combo_m_##SUFFIX { layers = <LAYER_ID_BASE>; timeout-ms = <TIMEOUT_COMBO_3>; key-positions = <KEY_O KEY_N KEY_T>; bindings = <&kp M>; }; \
        combo_u_##SUFFIX { layers = <LAYER_ID_BASE>; timeout-ms = <TIMEOUT_COMBO_2>; key-positions = <KEY_A KEY_T>; bindings = <&kp U>; }; \
        combo_w_##SUFFIX { layers = <LAYER_ID_BASE>; timeout-ms = <TIMEOUT_COMBO_3>; key-positions = <KEY_O KEY_H KEY_T>; bindings = <&kp W>; }; \
        combo_i_##SUFFIX { layers = <LAYER_ID_BASE>; timeout-ms = <TIMEOUT_COMBO_2>; key-positions = <KEY_E KEY_T>; bindings = <&kp I>; }; \
        combo_p_##SUFFIX { layers = <LAYER_ID_BASE>; timeout-ms = <TIMEOUT_COMBO_3>; key-positions = <KEY_O KEY_A KEY_T>; bindings = <&kp P>; }; \
        combo_d_##SUFFIX { layers = <LAYER_ID_BASE>; timeout-ms = <TIMEOUT_COMBO_2>; key-positions = <KEY_N KEY_T>; bindings = <&kp D>; }; \
        combo_k_##SUFFIX { layers = <LAYER_ID_BASE>; timeout-ms = <TIMEOUT_COMBO_3>; key-positions = <KEY_O KEY_E KEY_T>; bindings = <&kp K>; }; \
        combo_c_##SUFFIX { layers = <LAYER_ID_BASE>; timeout-ms = <TIMEOUT_COMBO_2>; key-positions = <KEY_H KEY_T>; bindings = <&kp C>; }; \
        combo_s_##SUFFIX { layers = <LAYER_ID_BASE>; timeout-ms = <TIMEOUT_COMBO_2>; key-positions = <KEY_O KEY_T>; bindings = <&kp S>; }; \
        combo_j_##SUFFIX { layers = <LAYER_ID_BASE>; timeout-ms = <TIMEOUT_COMBO_3>; key-positions = <KEY_N KEY_A KEY_T>; bindings = <&kp J>; }; \
        combo_v_##SUFFIX { layers = <LAYER_ID_BASE>; timeout-ms = <TIMEOUT_COMBO_3>; key-positions = <KEY_H KEY_E KEY_T>; bindings = <&kp V>; }; \
        combo_z_##SUFFIX { layers = <LAYER_ID_BASE>; timeout-ms = <TIMEOUT_COMBO_4>; key-positions = <KEY_O KEY_N KEY_A KEY_T>; bindings = <&kp Z>; }; \
        combo_under_##SUFFIX   { layers = <LAYER_ID_BASE>; timeout-ms = <TIMEOUT_COMBO_4>; key-positions = <KEY_O KEY_H KEY_E KEY_T>; bindings = <&kp UNDER>; }; \
        combo_grave_##SUFFIX   { layers = <LAYER_ID_BASE>; timeout-ms = <TIMEOUT_COMBO_3>; key-positions = <KEY_H KEY_A KEY_T>; bindings = <&kp GRAVE>; }; \
        combo_qmark_##SUFFIX   { layers = <LAYER_ID_BASE>; timeout-ms = <TIMEOUT_COMBO_3>; key-positions = <KEY_N KEY_E KEY_T>; bindings = <&kp QMARK>; }; \
        combo_squote_##SUFFIX  { layers = <LAYER_ID_SYM>; timeout-ms = <TIMEOUT_COMBO_2>; key-positions = <KEY_O KEY_N>; bindings = <&kp SQT>; }; \
        combo_dquote_##SUFFIX  { layers = <LAYER_ID_SYM>; timeout-ms = <TIMEOUT_COMBO_2>; key-positions = <KEY_O KEY_H>; bindings = <&kp DQT>; }; \
        combo_amps_##SUFFIX    { layers = <LAYER_ID_SYM>; timeout-ms = <TIMEOUT_COMBO_2>; key-positions = <KEY_O KEY_A>; bindings = <&kp AMPS>; }; \
        combo_dollar_##SUFFIX  { layers = <LAYER_ID_SYM>; timeout-ms = <TIMEOUT_COMBO_2>; key-positions = <KEY_O KEY_E>; bindings = <&kp DOLLAR>; }; \
        combo_lbkt_##SUFFIX    { layers = <LAYER_ID_SYM>; timeout-ms = <TIMEOUT_COMBO_2>; key-positions = <KEY_N KEY_A>; bindings = <&kp LBKT>; }; \
        combo_rbkt_##SUFFIX    { layers = <LAYER_ID_SYM>; timeout-ms = <TIMEOUT_COMBO_2>; key-positions = <KEY_H KEY_E>; bindings = <&kp RBKT>; }; \
        combo_bslh_##SUFFIX    { layers = <LAYER_ID_SYM>; timeout-ms = <TIMEOUT_COMBO_3>; key-positions = <KEY_O KEY_N KEY_A>; bindings = <&kp BSLH>; }; \
        combo_colon_##SUFFIX   { layers = <LAYER_ID_SYM>; timeout-ms = <TIMEOUT_COMBO_3>; key-positions = <KEY_O KEY_H KEY_E>; bindings = <&kp COLON>; }; \
        combo_lt_##SUFFIX      { layers = <LAYER_ID_SYM>; timeout-ms = <TIMEOUT_COMBO_3>; key-positions = <KEY_H KEY_A>; bindings = <&kp LT>; }; \
        combo_gt_##SUFFIX      { layers = <LAYER_ID_SYM>; timeout-ms = <TIMEOUT_COMBO_3>; key-positions = <KEY_N KEY_E>; bindings = <&kp GT>; }; \
        combo_n5_##SUFFIX      { layers = <LAYER_ID_BASE>; timeout-ms = <TIMEOUT_COMBO_3>; key-positions = <KEY_O KEY_N KEY_BSPC>; bindings = <&kp N5>; }; \
        combo_n3_##SUFFIX      { layers = <LAYER_ID_BASE>; timeout-ms = <TIMEOUT_COMBO_2>; key-positions = <KEY_A KEY_BSPC>; bindings = <&kp N3>; }; \
        combo_n6_##SUFFIX      { layers = <LAYER_ID_BASE>; timeout-ms = <TIMEOUT_COMBO_3>; key-positions = <KEY_O KEY_H KEY_BSPC>; bindings = <&kp N6>; }; \
        combo_n4_##SUFFIX      { layers = <LAYER_ID_BASE>; timeout-ms = <TIMEOUT_COMBO_2>; key-positions = <KEY_E KEY_BSPC>; bindings = <&kp N4>; }; \
        combo_n7_##SUFFIX      { layers = <LAYER_ID_BASE>; timeout-ms = <TIMEOUT_COMBO_3>; key-positions = <KEY_O KEY_A KEY_BSPC>; bindings = <&kp N7>; }; \
        combo_n1_##SUFFIX      { layers = <LAYER_ID_BASE>; timeout-ms = <TIMEOUT_COMBO_2>; key-positions = <KEY_N KEY_BSPC>; bindings = <&kp N1>; }; \
        combo_n8_##SUFFIX      { layers = <LAYER_ID_BASE>; timeout-ms = <TIMEOUT_COMBO_3>; key-positions = <KEY_O KEY_E KEY_BSPC>; bindings = <&kp N8>; }; \
        combo_n2_##SUFFIX      { layers = <LAYER_ID_BASE>; timeout-ms = <TIMEOUT_COMBO_2>; key-positions = <KEY_H KEY_BSPC>; bindings = <&kp N2>; }; \
        combo_minus_##SUFFIX   { layers = <LAYER_ID_BASE>; timeout-ms = <TIMEOUT_COMBO_2>; key-positions = <KEY_O KEY_BSPC>; bindings = <&kp MINUS>; }; \
        combo_n9_##SUFFIX      { layers = <LAYER_ID_BASE>; timeout-ms = <TIMEOUT_COMBO_3>; key-positions = <KEY_N KEY_A KEY_BSPC>; bindings = <&kp N9>; }; \
        combo_n0_##SUFFIX      { layers = <LAYER_ID_BASE>; timeout-ms = <TIMEOUT_COMBO_3>; key-positions = <KEY_H KEY_E KEY_BSPC>; bindings = <&kp N0>; }; \
        combo_equal_##SUFFIX   { layers = <LAYER_ID_BASE>; timeout-ms = <TIMEOUT_COMBO_4>; key-positions = <KEY_O KEY_N KEY_A KEY_BSPC>; bindings = <&kp EQUAL>; }; \
        combo_plus_##SUFFIX    { layers = <LAYER_ID_BASE>; timeout-ms = <TIMEOUT_COMBO_4>; key-positions = <KEY_O KEY_H KEY_E KEY_BSPC>; bindings = <&kp PLUS>; }; \
        combo_astrk_##SUFFIX   { layers = <LAYER_ID_BASE>; timeout-ms = <TIMEOUT_COMBO_3>; key-positions = <KEY_H KEY_A KEY_BSPC>; bindings = <&kp ASTRK>; }; \
        combo_fslh_##SUFFIX    { layers = <LAYER_ID_BASE>; timeout-ms = <TIMEOUT_COMBO_3>; key-positions = <KEY_N KEY_E KEY_BSPC>; bindings = <&kp FSLH>; }; \
        combo_f5_##SUFFIX      { layers = <LAYER_ID_BASE>; timeout-ms = <TIMEOUT_COMBO_4>; key-positions = <KEY_SPACE KEY_O KEY_N KEY_BSPC>; bindings = <&kp F5>; }; \
        combo_f3_##SUFFIX      { layers = <LAYER_ID_BASE>; timeout-ms = <TIMEOUT_COMBO_3>; key-positions = <KEY_SPACE KEY_A KEY_BSPC>; bindings = <&kp F3>; }; \
        combo_f6_##SUFFIX      { layers = <LAYER_ID_BASE>; timeout-ms = <TIMEOUT_COMBO_4>; key-positions = <KEY_SPACE KEY_O KEY_H KEY_BSPC>; bindings = <&kp F6>; }; \
        combo_f4_##SUFFIX      { layers = <LAYER_ID_BASE>; timeout-ms = <TIMEOUT_COMBO_3>; key-positions = <KEY_SPACE KEY_E KEY_BSPC>; bindings = <&kp F4>; }; \
        combo_f7_##SUFFIX      { layers = <LAYER_ID_BASE>; timeout-ms = <TIMEOUT_COMBO_4>; key-positions = <KEY_SPACE KEY_O KEY_A KEY_BSPC>; bindings = <&kp F7>; }; \
        combo_f1_##SUFFIX      { layers = <LAYER_ID_BASE>; timeout-ms = <TIMEOUT_COMBO_3>; key-positions = <KEY_SPACE KEY_N KEY_BSPC>; bindings = <&kp F1>; }; \
        combo_f8_##SUFFIX      { layers = <LAYER_ID_BASE>; timeout-ms = <TIMEOUT_COMBO_4>; key-positions = <KEY_SPACE KEY_O KEY_E KEY_BSPC>; bindings = <&kp F8>; }; \
        combo_f2_##SUFFIX      { layers = <LAYER_ID_BASE>; timeout-ms = <TIMEOUT_COMBO_3>; key-positions = <KEY_SPACE KEY_H KEY_BSPC>; bindings = <&kp F2>; }; \
        combo_pscrn_##SUFFIX   { layers = <LAYER_ID_BASE>; timeout-ms = <TIMEOUT_COMBO_3>; key-positions = <KEY_SPACE KEY_O KEY_BSPC>; bindings = <&kp PSCRN>; }; \
        combo_f9_##SUFFIX      { layers = <LAYER_ID_BASE>; timeout-ms = <TIMEOUT_COMBO_4>; key-positions = <KEY_SPACE KEY_N KEY_A KEY_BSPC>; bindings = <&kp F9>; }; \
        combo_f10_##SUFFIX     { layers = <LAYER_ID_BASE>; timeout-ms = <TIMEOUT_COMBO_4>; key-positions = <KEY_SPACE KEY_H KEY_E KEY_BSPC>; bindings = <&kp F10>; }; \
        combo_f11_##SUFFIX     { layers = <LAYER_ID_BASE>; timeout-ms = <TIMEOUT_COMBO_5>; key-positions = <KEY_SPACE KEY_O KEY_N KEY_A KEY_BSPC>; bindings = <&kp F11>; }; \
        combo_f12_##SUFFIX     { layers = <LAYER_ID_BASE>; timeout-ms = <TIMEOUT_COMBO_5>; key-positions = <KEY_SPACE KEY_O KEY_H KEY_E KEY_BSPC>; bindings = <&kp F12>; }; \
        combo_br_up_##SUFFIX   { layers = <LAYER_ID_BASE>; timeout-ms = <TIMEOUT_COMBO_4>; key-positions = <KEY_SPACE KEY_H KEY_A KEY_BSPC>; bindings = <&kp C_BRI_UP>; }; \
        combo_br_dn_##SUFFIX   { layers = <LAYER_ID_BASE>; timeout-ms = <TIMEOUT_COMBO_4>; key-positions = <KEY_SPACE KEY_N KEY_E KEY_BSPC>; bindings = <&kp C_BRI_DN>; }; \
        combo_ble_2_##SUFFIX     { layers = <LAYER_ID_BASE>; timeout-ms = <TIMEOUT_COMBO_3>; key-positions = <KEY_SPACE KEY_BSPC KEY_T KEY_A>; bindings = <&bt BT_SEL 2>; }; \
        combo_ble_3_##SUFFIX     { layers = <LAYER_ID_BASE>; timeout-ms = <TIMEOUT_COMBO_3>; key-positions = <KEY_SPACE KEY_BSPC KEY_T KEY_E>; bindings = <&bt BT_SEL 3>; }; \
        combo_ble_dc_0_##SUFFIX  { layers = <LAYER_ID_BASE>; timeout-ms = <TIMEOUT_COMBO_4>; key-positions = <KEY_SPACE KEY_BSPC KEY_T KEY_O KEY_N>; bindings = <&bt BT_DISC 0>; }; \
        combo_ble_dc_1_##SUFFIX  { layers = <LAYER_ID_BASE>; timeout-ms = <TIMEOUT_COMBO_4>; key-positions = <KEY_SPACE KEY_BSPC KEY_T KEY_O KEY_H>; bindings = <&bt BT_DISC 1>; }; \
        combo_ble_0_##SUFFIX     { layers = <LAYER_ID_BASE>; timeout-ms = <TIMEOUT_COMBO_3>; key-positions = <KEY_SPACE KEY_BSPC KEY_T KEY_N>; bindings = <&bt BT_SEL 0>; }; \
        combo_ble_1_##SUFFIX     { layers = <LAYER_ID_BASE>; timeout-ms = <TIMEOUT_COMBO_3>; key-positions = <KEY_SPACE KEY_BSPC KEY_T KEY_H>; bindings = <&bt BT_SEL 1>; }; \
        combo_ble_dc_2_##SUFFIX  { layers = <LAYER_ID_BASE>; timeout-ms = <TIMEOUT_COMBO_4>; key-positions = <KEY_SPACE KEY_BSPC KEY_T KEY_O KEY_A>; bindings = <&bt BT_SEL 2>; }; \
        combo_ble_dc_3_##SUFFIX  { layers = <LAYER_ID_BASE>; timeout-ms = <TIMEOUT_COMBO_4>; key-positions = <KEY_SPACE KEY_BSPC KEY_T KEY_O KEY_E>; bindings = <&bt BT_SEL 3>; }; \
        combo_ble_clr_##SUFFIX   { layers = <LAYER_ID_BASE>; timeout-ms = <TIMEOUT_COMBO_4>; key-positions = <KEY_SPACE KEY_BSPC KEY_T KEY_O KEY_N KEY_A>; bindings = <&bt BT_CLR>; }; \
        combo_ble_clr_a_##SUFFIX { layers = <LAYER_ID_BASE>; timeout-ms = <TIMEOUT_COMBO_4>; key-positions = <KEY_SPACE KEY_BSPC KEY_T KEY_O KEY_H KEY_E>; bindings = <&bt BT_CLR>; }; \
        combo_pg_up_##SUFFIX   { layers = <LAYER_ID_NAV>; timeout-ms = <TIMEOUT_COMBO_2>; key-positions = <KEY_O KEY_N>; bindings = <&kp PG_UP>; }; \
        combo_pg_dn_##SUFFIX   { layers = <LAYER_ID_NAV>; timeout-ms = <TIMEOUT_COMBO_2>; key-positions = <KEY_O KEY_H>; bindings = <&kp PG_DN>; }; \
        combo_home_##SUFFIX    { layers = <LAYER_ID_NAV>; timeout-ms = <TIMEOUT_COMBO_2>; key-positions = <KEY_O KEY_A>; bindings = <&kp HOME>; }; \
        combo_end_##SUFFIX     { layers = <LAYER_ID_NAV>; timeout-ms = <TIMEOUT_COMBO_2>; key-positions = <KEY_O KEY_E>; bindings = <&kp END>; }; \
        combo_copy_##SUFFIX    { layers = <LAYER_ID_NAV>; timeout-ms = <TIMEOUT_COMBO_2>; key-positions = <KEY_N KEY_A>; bindings = <&kp C_AC_COPY>; }; \
        combo_paste_##SUFFIX   { layers = <LAYER_ID_NAV>; timeout-ms = <TIMEOUT_COMBO_2>; key-positions = <KEY_H KEY_E>; bindings = <&kp C_AC_PASTE>; }; \
        combo_volup_##SUFFIX   { layers = <LAYER_ID_NAV>; timeout-ms = <TIMEOUT_COMBO_3>; key-positions = <KEY_O KEY_N KEY_A>; bindings = <&kp C_VOL_UP>; }; \
        combo_voldn_##SUFFIX   { layers = <LAYER_ID_NAV>; timeout-ms = <TIMEOUT_COMBO_3>; key-positions = <KEY_O KEY_H KEY_E>; bindings = <&kp C_VOL_DN>; }; \
        combo_hash_##SUFFIX    { layers = <LAYER_ID_NAV>; timeout-ms = <TIMEOUT_COMBO_2>; key-positions = <KEY_H KEY_A>; bindings = <&kp HASH>; }; \
        combo_excl_##SUFFIX    { layers = <LAYER_ID_NAV>; timeout-ms = <TIMEOUT_COMBO_2>; key-positions = <KEY_N KEY_E>; bindings = <&kp EXCL>; }; \
        combo_scrl_up_##SUFFIX { layers = <LAYER_ID_MWS>; timeout-ms = <TIMEOUT_COMBO_2>; key-positions = <KEY_O KEY_N>; bindings = <&msc SCRL_UP>; }; \
        combo_scrl_dn_##SUFFIX { layers = <LAYER_ID_MWS>; timeout-ms = <TIMEOUT_COMBO_2>; key-positions = <KEY_O KEY_H>; bindings = <&msc SCRL_DOWN>; }; \
        combo_scrl_l_##SUFFIX  { layers = <LAYER_ID_MWS>; timeout-ms = <TIMEOUT_COMBO_2>; key-positions = <KEY_O KEY_A>; bindings = <&msc SCRL_LEFT>; }; \
        combo_scrl_r_##SUFFIX  { layers = <LAYER_ID_MWS>; timeout-ms = <TIMEOUT_COMBO_2>; key-positions = <KEY_O KEY_E>; bindings = <&msc SCRL_RIGHT>; }; \
        combo_m4_##SUFFIX      { layers = <LAYER_ID_MWS>; timeout-ms = <TIMEOUT_COMBO_2>; key-positions = <KEY_N KEY_A>; bindings = <&mkp MB4>; }; \
        combo_m5_##SUFFIX      { layers = <LAYER_ID_MWS>; timeout-ms = <TIMEOUT_COMBO_2>; key-positions = <KEY_H KEY_E>; bindings = <&mkp MB5>; }; \
        combo_shift_##SUFFIX   { layers = <LAYER_ID_BASE>; timeout-ms = <TIMEOUT_COMBO_2>; key-positions = <KEY_SPACE KEY_O>; bindings = <&sk LSHFT>; }; \
        combo_gui_##SUFFIX     { layers = <LAYER_ID_BASE>; timeout-ms = <TIMEOUT_COMBO_2>; key-positions = <KEY_SPACE KEY_H>; bindings = <&sk LGUI>; }; \
        combo_alt_##SUFFIX     { layers = <LAYER_ID_BASE>; timeout-ms = <TIMEOUT_COMBO_3>; key-positions = <KEY_SPACE KEY_O KEY_A>; bindings = <&sk LALT>; }; \
        combo_ctrl_##SUFFIX    { layers = <LAYER_ID_BASE>; timeout-ms = <TIMEOUT_COMBO_3>; key-positions = <KEY_SPACE KEY_O KEY_E>; bindings = <&sk LCTRL>; }; \
        combo_insert_##SUFFIX  { layers = <LAYER_ID_BASE>; timeout-ms = <TIMEOUT_COMBO_3>; key-positions = <KEY_SPACE KEY_O KEY_H>; bindings = <&kp INSERT>; }; \
        combo_tab_##SUFFIX     { layers = <LAYER_ID_BASE>; timeout-ms = <TIMEOUT_COMBO_2>; key-positions = <KEY_SPACE KEY_A>; bindings = <&kp TAB>; }; \
        combo_escape_##SUFFIX  { layers = <LAYER_ID_BASE>; timeout-ms = <TIMEOUT_COMBO_3>; key-positions = <KEY_SPACE KEY_N>; bindings = <&kp ESCAPE>; }; \
        combo_enter_##SUFFIX   { layers = <LAYER_ID_BASE>; timeout-ms = <TIMEOUT_COMBO_2>; key-positions = <KEY_SPACE KEY_E>; bindings = <&kp ENTER>; }
